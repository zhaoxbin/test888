AUTOSAR XML (schema 4-0-3)
package /DaVinci_Project
  module config Com
    ComConfig
      33 x ComSignal:
        CGW_03_CRC_oCGW_03_oNIO_ES6_RF_CAN_SR_V3_0_bd877a03_Rx: ComSignalType=UINT8
        CGW_03_MsgCntr_oCGW_03_oNIO_ES6_RF_CAN_SR_V3_0_3e603ff9_Rx: ComSignalType=UINT8
        CGW_WLC_CRC_oCGW_WLC_oNIO_ES6_RF_CAN_SR_V3_0_67a87047_Rx: ComSignalType=UINT8
        CGW_WLC_MsgCntr_oCGW_WLC_oNIO_ES6_RF_CAN_SR_V3_0_2e39b55e_Rx: ComSignalType=UINT8
        ComfEna_ASIL_oCGW_03_oNIO_ES6_RF_CAN_SR_V3_0_daac19b6_Rx: ComSignalType=UINT8
        ComfEna_oCGW_02_oNIO_ES6_RF_CAN_SR_V3_0_1a60ba8c_Rx: ComSignalType=UINT8
        Day_oCGW_TCU_01_oNIO_ES6_RF_CAN_SR_V3_0_76626f65_Rx: ComSignalType=UINT8
        Hr_oCGW_TCU_01_oNIO_ES6_RF_CAN_SR_V3_0_f5c3e99f_Rx: ComSignalType=UINT8
        ImobEnaReq_oCGW_02_oNIO_ES6_RF_CAN_SR_V3_0_a2f30745_Rx: ComSignalType=UINT8
        Min_oCGW_TCU_01_oNIO_ES6_RF_CAN_SR_V3_0_c05ffcb3_Rx: ComSignalType=UINT8
        Mth_oCGW_TCU_01_oNIO_ES6_RF_CAN_SR_V3_0_a0768b21_Rx: ComSignalType=UINT8
        Sec_oCGW_TCU_01_oNIO_ES6_RF_CAN_SR_V3_0_48a1d09a_Rx: ComSignalType=UINT8
        UsrData0_WLC_oNM_WLC_oNIO_ES6_RF_CAN_SR_V3_0_9b82ce18_Tx: ComSignalType=UINT8
        UsrData1_WLC_oNM_WLC_oNIO_ES6_RF_CAN_SR_V3_0_1b72d907_Tx: ComSignalType=UINT8
        UsrData2_WLC_oNM_WLC_oNIO_ES6_RF_CAN_SR_V3_0_4113e667_Tx: ComSignalType=UINT8
        UsrData3_WLC_oNM_WLC_oNIO_ES6_RF_CAN_SR_V3_0_c1e3f178_Tx: ComSignalType=UINT8
        UsrData4_WLC_oNM_WLC_oNIO_ES6_RF_CAN_SR_V3_0_f5d198a7_Tx: ComSignalType=UINT8
        UsrData5_WLC_oNM_WLC_oNIO_ES6_RF_CAN_SR_V3_0_75218fb8_Tx: ComSignalType=UINT8
        VehOdometer_oCDC_IC_01_oNIO_ES6_RF_CAN_SR_V3_0_c4f897da_Rx: ComSignalType=UINT32
        VehSpd_oBCU_04_oNIO_ES6_RF_CAN_SR_V3_0_91cf0813_Rx: ComSignalType=UINT16
        VehState_ASIL_oCGW_03_oNIO_ES6_RF_CAN_SR_V3_0_3e049202_Rx: ComSignalType=UINT8
        VehState_oCGW_02_oNIO_ES6_RF_CAN_SR_V3_0_70d412f9_Rx: ComSignalType=UINT8
        WLCChrgFctEnaReq_oCDC_WLC_oNIO_ES6_RF_CAN_SR_V3_0_e37de241_Rx: ComSignalType=UINT8
        WLCChrgRate_oWLC_01_oNIO_ES6_RF_CAN_SR_V3_0_b69382aa_Tx: ComSignalType=UINT8
        WLCChrgSts_oWLC_01_oNIO_ES6_RF_CAN_SR_V3_0_eda08377_Tx: ComSignalType=UINT8
        WLCCtrlSts_oWLC_01_oNIO_ES6_RF_CAN_SR_V3_0_a083bd17_Tx: ComSignalType=UINT8
        WLCFailSts_oWLC_01_oNIO_ES6_RF_CAN_SR_V3_0_882ea33c_Tx: ComSignalType=UINT8
        WLCImobSts_oWLC_02_oNIO_ES6_RF_CAN_SR_V3_0_77a54935_Tx: ComSignalType=UINT8
        WLCMuteViaHW_oWLC_01_oNIO_ES6_RF_CAN_SR_V3_0_990775ce_Tx: ComSignalType=BOOLEAN
        WLC_01_CRC_oWLC_01_oNIO_ES6_RF_CAN_SR_V3_0_705754f3_Tx: ComSignalType=UINT8
        WLC_01_MsgCntr_oWLC_01_oNIO_ES6_RF_CAN_SR_V3_0_c3fc8f8f_Tx: ComSignalType=UINT8
        WLC_02_MsgCntr_oWLC_02_oNIO_ES6_RF_CAN_SR_V3_0_15588e7e_Tx: ComSignalType=UINT8
        Yr_oCGW_TCU_01_oNIO_ES6_RF_CAN_SR_V3_0_cdf9e710_Rx: ComSignalType=UINT8
  module config Rte
    19 x RteBswModuleInstance:
      BswM
        BswM_MainFunctionTimingEvent0 (RteBswEventToTaskMapping): RteBswUsedOsEventRef=Rte_Ev_Cyclic2_OsTask_BSW_SCHM_0_10ms, RteBswUsedOsAlarmRef=Os/Rte_Al_TE2_OsTask_BSW_SCHM_0_10ms
      Can
        3 x RteBswEventToTaskMapping, all with RteBswUsedOsEventRef=Rte_Ev_Cyclic2_OsTask_BSW_SCHM_0_10ms, RteBswUsedOsAlarmRef=Os/Rte_Al_TE2_OsTask_BSW_SCHM_0_10ms:
          Can_MainFunction_BusOffTimingEvent0
          Can_MainFunction_ModeTimingEvent0
          Can_MainFunction_WakeupTimingEvent0
      CanIf
      CanNm
        CanNm_MainFunctionTimingEvent0 (RteBswEventToTaskMapping): RteBswUsedOsEventRef=Rte_Ev_Cyclic2_OsTask_BSW_SCHM_0_10ms, RteBswUsedOsAlarmRef=Os/Rte_Al_TE2_OsTask_BSW_SCHM_0_10ms
      CanSM
        CanSM_MainFunctionTimingEvent0 (RteBswEventToTaskMapping): RteBswUsedOsEventRef=Rte_Ev_Cyclic2_OsTask_BSW_SCHM_0_10ms, RteBswUsedOsAlarmRef=Os/Rte_Al_TE2_OsTask_BSW_SCHM_0_10ms
      CanTp
        CanTp_MainFunctionTimingEvent0 (RteBswEventToTaskMapping): RteBswUsedOsEventRef=Rte_Ev_Cyclic2_OsTask_BSW_SCHM_0_5ms, RteBswUsedOsAlarmRef=Os/Rte_Al_TE2_OsTask_BSW_SCHM_0_5ms
      Com
        Com_MainFunctionRxTimingEvent0 (RteBswEventToTaskMapping): RteBswUsedOsEventRef=Rte_Ev_Cyclic2_OsTask_BSW_SCHM_0_10ms, RteBswUsedOsAlarmRef=Os/Rte_Al_TE2_OsTask_BSW_SCHM_0_10ms
        Com_MainFunctionTxTimingEvent0 (RteBswEventToTaskMapping): RteBswUsedOsEventRef=Rte_Ev_Cyclic2_OsTask_BSW_SCHM_0_10ms, RteBswUsedOsAlarmRef=Os/Rte_Al_TE2_OsTask_BSW_SCHM_0_10ms
      ComM
        ComM_MainFunction_0TimingEvent0 (RteBswEventToTaskMapping): RteBswUsedOsEventRef=Rte_Ev_Cyclic2_OsTask_BSW_SCHM_0_20ms, RteBswUsedOsAlarmRef=Os/Rte_Al_TE2_OsTask_BSW_SCHM_0_20ms
      Dcm
        Dcm_MainFunctionTimingEvent0 (RteBswEventToTaskMapping): RteBswUsedOsEventRef=Rte_Ev_Cyclic2_OsTask_BSW_SCHM_0_10ms, RteBswUsedOsAlarmRef=Os/Rte_Al_TE2_OsTask_BSW_SCHM_0_10ms
      Dem
        Dem_MasterMainFunctionTimingEvent0 (RteBswEventToTaskMapping): RteBswUsedOsEventRef=Rte_Ev_Cyclic2_OsTask_BSW_SCHM_0_10ms, RteBswUsedOsAlarmRef=Os/Rte_Al_TE2_OsTask_BSW_SCHM_0_10ms
        Dem_SatelliteMainFunctionTimingEvent0 (RteBswEventToTaskMapping): RteBswUsedOsEventRef=Rte_Ev_Cyclic2_OsTask_BSW_SCHM_0_10ms, RteBswUsedOsAlarmRef=Os/Rte_Al_TE2_OsTask_BSW_SCHM_0_10ms
      Det
      Dio
      EcuM
        EcuM_MainFunctionTimingEvent0 (RteBswEventToTaskMapping): RteBswUsedOsEventRef=Rte_Ev_Cyclic2_OsTask_BSW_SCHM_0_10ms, RteBswUsedOsAlarmRef=Os/Rte_Al_TE2_OsTask_BSW_SCHM_0_10ms
      Fee
        Fee_30_SmallSector_MainFunctionTimingEvent0 (RteBswEventToTaskMapping): RteBswUsedOsEventRef=Rte_Ev_Cyclic2_OsTask_BSW_SCHM_0_5ms, RteBswUsedOsAlarmRef=Os/Rte_Al_TE2_OsTask_BSW_SCHM_0_5ms
      Fls
        Fls_MainFunctionTimingEvent0 (RteBswEventToTaskMapping): RteBswUsedOsEventRef=Rte_Ev_Cyclic2_OsTask_BSW_SCHM_0_10ms, RteBswUsedOsAlarmRef=Os/Rte_Al_TE2_OsTask_BSW_SCHM_0_10ms
      Mcu
      Nm
      NvM
        NvM_MainFunctionTimingEvent0 (RteBswEventToTaskMapping): RteBswUsedOsEventRef=Rte_Ev_Cyclic2_OsTask_BSW_SCHM_0_10ms, RteBswUsedOsAlarmRef=Os/Rte_Al_TE2_OsTask_BSW_SCHM_0_10ms
      PduR
    11 x RteSwComponentInstance:
      BswM_EcuSwComposition
        Timer_BswM_MainFunction (RteEventToTaskMapping): RteUsedOsEventRef=Rte_Ev_Cyclic2_OsTask_BSW_SCHM_0_10ms, RteUsedOsAlarmRef=Os/Rte_Al_TE2_OsTask_BSW_SCHM_0_10ms
      ComM_EcuSwComposition
        Timer_ComM_MainFunction_0 (RteEventToTaskMapping): RteUsedOsEventRef=Rte_Ev_Cyclic2_OsTask_BSW_SCHM_0_20ms, RteUsedOsAlarmRef=Os/Rte_Al_TE2_OsTask_BSW_SCHM_0_20ms
      Communication_Read_APP_EcuSwComposition
        TMT_WLCAPP_Runnable (RteEventToTaskMapping): RteUsedOsEventRef=Rte_Ev_Cyclic_OsTask_APP_0_10ms, RteUsedOsAlarmRef=Os/Rte_Al_TE_OsTask_APP_0_10ms
      Dcm_EcuSwComposition
        Timer_Dcm_MainFunction (RteEventToTaskMapping): RteUsedOsEventRef=Rte_Ev_Cyclic2_OsTask_BSW_SCHM_0_10ms, RteUsedOsAlarmRef=Os/Rte_Al_TE2_OsTask_BSW_SCHM_0_10ms
      DemMaster_0_EcuSwComposition
        Timer_Dem_MasterMainFunction (RteEventToTaskMapping): RteUsedOsEventRef=Rte_Ev_Cyclic2_OsTask_BSW_SCHM_0_10ms, RteUsedOsAlarmRef=Os/Rte_Al_TE2_OsTask_BSW_SCHM_0_10ms
      DemSatellite_0_EcuSwComposition
        Timer_Dem_SatelliteMainFunction (RteEventToTaskMapping): RteUsedOsEventRef=Rte_Ev_Cyclic2_OsTask_BSW_SCHM_0_10ms, RteUsedOsAlarmRef=Os/Rte_Al_TE2_OsTask_BSW_SCHM_0_10ms
      Det_EcuSwComposition
      EcuM_EcuSwComposition
        Timer_EcuM_MainFunction (RteEventToTaskMapping): RteUsedOsEventRef=Rte_Ev_Cyclic2_OsTask_BSW_SCHM_0_10ms, RteUsedOsAlarmRef=Os/Rte_Al_TE2_OsTask_BSW_SCHM_0_10ms
      NvM_EcuSwComposition
        Timer_NvM_MainFunction (RteEventToTaskMapping): RteUsedOsEventRef=Rte_Ev_Cyclic2_OsTask_BSW_SCHM_0_10ms, RteUsedOsAlarmRef=Os/Rte_Al_TE2_OsTask_BSW_SCHM_0_10ms
      Os_OsCore0_swc_EcuSwComposition
      SWC_WLCAPP_EcuSwComposition
        TMT_DTCProcessRunable (RteEventToTaskMapping): RteUsedOsEventRef=Rte_Ev_Cyclic_OsTask_APP_0_10ms, RteUsedOsAlarmRef=Os/Rte_Al_TE_OsTask_APP_0_10ms
    RteOsInteraction
      4 x RteUsedOsActivation, all with RteExpectedActivationOffset=0:
        Rte_Al_TE_OsTask_APP_0_10ms: RteActivationOsAlarmRef=Os/Rte_Al_TE_OsTask_APP_0_10ms, RteActivationOsTaskRef=OsTask_APP
        Rte_Al_TE2_OsTask_BSW_SCHM_0_10ms: RteActivationOsAlarmRef=Os/Rte_Al_TE2_OsTask_BSW_SCHM_0_10ms, RteActivationOsTaskRef=OsTask_BSW_SCHM
        Rte_Al_TE2_OsTask_BSW_SCHM_0_20ms: RteActivationOsAlarmRef=Os/Rte_Al_TE2_OsTask_BSW_SCHM_0_20ms, RteActivationOsTaskRef=OsTask_BSW_SCHM
        Rte_Al_TE2_OsTask_BSW_SCHM_0_5ms: RteActivationOsAlarmRef=Os/Rte_Al_TE2_OsTask_BSW_SCHM_0_5ms, RteActivationOsTaskRef=OsTask_BSW_SCHM
  module config NvM
  module config Os
    OsTask_APP (OsTask): OsTaskActivation=1, OsTaskPriority=10, OsTaskSchedule=NON, OsTaskEventRef=Rte_Ev_Cyclic_OsTask_APP_0_10ms
    Rte_Al_TE_OsTask_APP_0_10ms (OsAlarm): OsAlarmCounterRef=SystemTimer
      OsAlarmAction
        OsAlarmSetEvent: OsAlarmSetEventRef=Rte_Ev_Cyclic_OsTask_APP_0_10ms, OsAlarmSetEventTaskRef=OsTask_APP
    OsTask_BSW_SCHM (OsTask):
      OsTaskActivation = 1
      OsTaskPriority = 0
      OsTaskSchedule = FULL
      OsTaskEventRef = Rte_Ev_Cyclic2_OsTask_BSW_SCHM_0_10ms
      OsTaskEventRef = Rte_Ev_Cyclic2_OsTask_BSW_SCHM_0_20ms
      OsTaskEventRef = Rte_Ev_Cyclic2_OsTask_BSW_SCHM_0_5ms
    3 x OsAlarm, all with OsAlarmCounterRef=SystemTimer:
      Rte_Al_TE2_OsTask_BSW_SCHM_0_10ms
        OsAlarmAction
          OsAlarmSetEvent: OsAlarmSetEventRef=Rte_Ev_Cyclic2_OsTask_BSW_SCHM_0_10ms, OsAlarmSetEventTaskRef=OsTask_BSW_SCHM
      Rte_Al_TE2_OsTask_BSW_SCHM_0_20ms
        OsAlarmAction
          OsAlarmSetEvent: OsAlarmSetEventRef=Rte_Ev_Cyclic2_OsTask_BSW_SCHM_0_20ms, OsAlarmSetEventTaskRef=OsTask_BSW_SCHM
      Rte_Al_TE2_OsTask_BSW_SCHM_0_5ms
        OsAlarmAction
          OsAlarmSetEvent: OsAlarmSetEventRef=Rte_Ev_Cyclic2_OsTask_BSW_SCHM_0_5ms, OsAlarmSetEventTaskRef=OsTask_BSW_SCHM
    4 x OsEvent:
      Rte_Ev_Cyclic2_OsTask_BSW_SCHM_0_10ms
      Rte_Ev_Cyclic2_OsTask_BSW_SCHM_0_20ms
      Rte_Ev_Cyclic2_OsTask_BSW_SCHM_0_5ms
      Rte_Ev_Cyclic_OsTask_APP_0_10ms
  module config EcuC
  ecuc value collection DaVinci_Project: ecuc-values=[Com, Rte, Os, EcuC, NvM]
